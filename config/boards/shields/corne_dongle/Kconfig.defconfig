## config/boards/shields/kometa_dongle/Kconfig.shield
```kconfig
# SPDX-License-Identifier: MIT

config SHIELD_KOMETA_DONGLE
    def_bool $(shields_list_contains,kometa_dongle)
```

## config/boards/shields/universal_dongle/Kconfig.shield
```kconfig
# SPDX-License-Identifier: MIT

config SHIELD_UNIVERSAL_DONGLE
    def_bool $(shields_list_contains,universal_dongle)
```
